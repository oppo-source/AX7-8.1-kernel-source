## drivers/power/Kconfig
```kconfig
#ifdef VENDOR_EDIT /* Jianchao.Shi@BSP.CHG.Basic, 2016/12/20, sjc Delete for charging */
config OPPO_CHARGE_450_O
	tristate "CONFIG_OPPO_CHARGE_450_O driver"
	depends on MFD_SPMI_PMIC
	help
	  Enables support for the oppo charging framework

config OPPO_SHORT_C_BATT_CHECK
	tristate "OPPO_SHORT_C_BATT CHECK SUPPORT"
	default n
	depends on MFD_SPMI_PMIC
	help
	  Say Y to include support

config OPPO_RTC_DET_SUPPORT
	tristate "OPPO RTC DET SUPPORT"
	default n
	depends on MFD_SPMI_PMIC
	help
	  Say Y to include support

config OPPO_CHECK_CHARGERID_VOLT
	tristate "OPPO CHECK CHARGERID VOLT"
	default n
	depends on MFD_SPMI_PMIC
	help
	  Say Y to include support

config OPPO_SHIP_MODE_SUPPORT
	tristate "OPPO_SHIP_MODE_SUPPORT"
	default n
	depends on MFD_SPMI_PMIC
	help
	  Say Y to include support
	  
config OPPO_SHORT_HW_CHECK
	bool "OPPO batt HW SHORT "
	help
	  Say Y here to declare charging system is on MTK	  
source "drivers/power/oppo/Kconfig"
#endif

source "drivers/power/avs/Kconfig"
source "drivers/power/reset/Kconfig"
source "drivers/power/supply/Kconfig"
source "drivers/power/qcom/Kconfig"
```

## drivers/soc/oppo/Kconfig
```kconfig
# ifdef VENDOR_EDIT 
# yixue.ge add for config oppo software common soft
config OPPO_ARCH_FILE
	bool "for build directory oppo"
	---help---
	say Y to buid in

config OPPO_COMMON_SOFT
      bool "config oppo common software"
	  select OPPO_ARCH_FILE
	  help
		define this config to get project verion from sharemem.
		Maybe this value is from CDT or dynamic identify by hardware
		id.

config OPPO_DEVICE_IFNO
      bool "config oppo devinfo"
	  select OPPO_ARCH_FILE
	  help
		define this config to compile devinfo.c for device register
		.
source "drivers/soc/oppo/oppo_project/Kconfig"

#ifdef VENDOR_EDIT
#//zhenwenxian@BSP.Power.Basic, 2017/01/12, Add for NV recovery
source "drivers/soc/oppo/oppo_mdmrst/Kconfig"
#endif /* VENDOR_EDIT */
```
