/* Copyright (c) 2013, The Linux Foundation. All rights reserved.
 *
 * This program is free software; you can redistribute it and/or modify
 * it under the terms of the GNU General Public License version 2 and
 * only version 2 as published by the Free Software Foundation.
 *
 * This program is distributed in the hope that it will be useful,
 * but WITHOUT ANY WARRANTY; without even the implied warranty of
 * MERCHANTABILITY or FITNESS FOR A PARTICULAR PURPOSE.  See the
 * GNU General Public License for more details.
 */

/*---------------------------------------------------------------------------
 * This file is autogenerated file using gcdb parser. Please do not edit it.
 * Update input XML file to add a new entry or update variable in this file
 * VERSION = "1.0"
 *---------------------------------------------------------------------------*/
&mdss_mdp {
	dsi_oppo18031tianma_nt36525_720p_video: qcom,mdss_dsi_oppo18031tianma_nt36525_720p_video {
		qcom,mdss-dsi-panel-name = "oppo18031tianma nt36525 720p video mode dsi panel";
		qcom,mdss-dsi-panel-manufacture = "TIANMA";
		qcom,mdss-dsi-panel-version = "nt36525";
		qcom,mdss-dsi-panel-controller = <&mdss_dsi0>;
		qcom,mdss-dsi-panel-type = "dsi_video_mode";
		qcom,mdss-dsi-panel-destination = "display_1";
		qcom,mdss-dsi-panel-framerate = <60>;
		qcom,mdss-dsi-virtual-channel-id = <0>;
		qcom,mdss-dsi-stream = <0>;
		qcom,mdss-dsi-panel-width = <720>;
		qcom,mdss-dsi-panel-height = <1520>;
		qcom,mdss-dsi-h-front-porch = <70>;
		qcom,mdss-dsi-h-back-porch = <90>;
		qcom,mdss-dsi-h-pulse-width = <2>;
		qcom,mdss-dsi-h-sync-skew = <0>;
		qcom,mdss-dsi-v-back-porch = <4>;
		qcom,mdss-dsi-v-front-porch = <6>;
		qcom,mdss-dsi-v-pulse-width = <2>;
		qcom,mdss-dsi-h-left-border = <0>;
		qcom,mdss-dsi-h-right-border = <0>;
		qcom,mdss-dsi-v-top-border = <0>;
		qcom,mdss-dsi-v-bottom-border = <0>;
		qcom,mdss-dsi-bpp = <24>;
		qcom,mdss-dsi-underflow-color = <0xff>;
		qcom,mdss-dsi-border-color = <0>;
		qcom,mdss-dsi-on-command = [29 01 00 00 0A 00 02 FF 20
			29 01 00 00 00 00 02 FB 01
			29 01 00 00 00 00 02 05 A9
			29 01 00 00 00 00 02 07 6E
			29 01 00 00 00 00 02 08 AD
			29 01 00 00 00 00 02 0E 87
			29 01 00 00 00 00 02 0F 46
			29 01 00 00 00 00 02 69 A9
			29 01 00 00 00 00 02 87 02
			29 01 00 00 00 00 02 89 95
			29 01 00 00 00 00 02 8A A8
			29 01 00 00 00 00 02 8B 95
			29 01 00 00 00 00 02 8C A8
			29 01 00 00 00 00 02 94 40
			29 01 00 00 00 00 02 95 E1
			29 01 00 00 00 00 02 96 09
			29 01 00 00 0A 00 02 FF 24
			29 01 00 00 00 00 02 FB 01
			29 01 00 00 00 00 02 00 00
			29 01 00 00 00 00 02 01 1E
			29 01 00 00 00 00 02 02 23
			29 01 00 00 00 00 02 03 08
			29 01 00 00 00 00 02 04 08
			29 01 00 00 00 00 02 05 00
			29 01 00 00 00 00 02 06 00
			29 01 00 00 00 00 02 07 04
			29 01 00 00 00 00 02 08 05
			29 01 00 00 00 00 02 09 17
			29 01 00 00 00 00 02 0A 16
			29 01 00 00 00 00 02 0B 15
			29 01 00 00 00 00 02 0C 14
			29 01 00 00 00 00 02 16 00
			29 01 00 00 00 00 02 17 1E
			29 01 00 00 00 00 02 18 23
			29 01 00 00 00 00 02 19 08
			29 01 00 00 00 00 02 1A 08
			29 01 00 00 00 00 02 1B 00
			29 01 00 00 00 00 02 1C 00
			29 01 00 00 00 00 02 1D 04
			29 01 00 00 00 00 02 1E 05
			29 01 00 00 00 00 02 1F 0F
			29 01 00 00 00 00 02 20 0E
			29 01 00 00 00 00 02 21 0D
			29 01 00 00 00 00 02 22 0C
			29 01 00 00 00 00 02 37 44
			29 01 00 00 00 00 02 2F 06
			29 01 00 00 00 00 02 30 04
			29 01 00 00 00 00 02 33 04
			29 01 00 00 00 00 02 34 06
			29 01 00 00 00 00 02 39 00
			29 01 00 00 00 00 02 3A 60
			29 01 00 00 00 00 02 3B 8C
			29 01 00 00 00 00 02 3D 52
			29 01 00 00 00 00 02 3F 0A
			29 01 00 00 00 00 02 43 0A
			29 01 00 00 00 00 02 47 44
			29 01 00 00 00 00 02 4A 05
			29 01 00 00 00 00 02 4B 50
			29 01 00 00 00 00 02 4C 51
			29 01 00 00 00 00 02 4D 12
			29 01 00 00 00 00 02 4E 34
			29 01 00 00 00 00 02 51 43
			29 01 00 00 00 00 02 52 21
			29 01 00 00 00 00 02 55 43
			29 01 00 00 00 00 02 56 44
			29 01 00 00 00 00 02 58 21
			29 01 00 00 00 00 02 59 00
			29 01 00 00 00 00 02 5A A0
			29 01 00 00 00 00 02 5B 97
			29 01 00 00 00 00 02 5C 8F
			29 01 00 00 00 00 02 5D 0A
			29 01 00 00 00 00 02 5E 04
			29 01 00 00 00 00 02 60 80
			29 01 00 00 00 00 02 61 7C
			29 01 00 00 00 00 02 64 10
			29 01 00 00 00 00 02 68 12
			29 01 00 00 00 00 02 69 34
			29 01 00 00 00 00 02 6A 43
			29 01 00 00 00 00 02 6B 21
			29 01 00 00 00 00 02 6C 43
			29 01 00 00 00 00 02 6D 44
			29 01 00 00 00 00 02 6E 21
			29 01 00 00 00 00 02 6F 00
			29 01 00 00 00 00 02 70 A0
			29 01 00 00 00 00 02 71 97
			29 01 00 00 00 00 02 72 8F
			29 01 00 00 00 00 02 73 0A
			29 01 00 00 00 00 02 74 04
			29 01 00 00 00 00 02 85 02
			29 01 00 00 00 00 02 92 B1
			29 01 00 00 00 00 02 93 06
			29 01 00 00 00 00 02 94 06
			29 01 00 00 00 00 02 9D 30
			29 01 00 00 00 00 02 AB 00
			29 01 00 00 00 00 02 AC 00
			29 01 00 00 00 00 02 AD 00
			29 01 00 00 00 00 02 B0 14
			29 01 00 00 00 00 02 B1 9D
			29 01 00 00 0A 00 02 FF 25
			29 01 00 00 00 00 02 FB 01
			29 01 00 00 00 00 02 0A 82
			29 01 00 00 00 00 02 0B 9D
			29 01 00 00 00 00 02 0C 01
			29 01 00 00 00 00 02 17 82
			29 01 00 00 00 00 02 18 06
			29 01 00 00 00 00 02 19 0F
			29 01 00 00 00 00 02 1E 00
			29 01 00 00 00 00 02 1F A0
			29 01 00 00 00 00 02 20 97
			29 01 00 00 00 00 02 21 A0
			29 01 00 00 00 00 02 22 97
			29 01 00 00 00 00 02 23 14
			29 01 00 00 00 00 02 24 9D
			29 01 00 00 00 00 02 25 00
			29 01 00 00 00 00 02 26 A0
			29 01 00 00 00 00 02 27 97
			29 01 00 00 00 00 02 28 A0
			29 01 00 00 00 00 02 29 97
			29 01 00 00 00 00 02 2A 14
			29 01 00 00 00 00 02 2B 9D
			29 01 00 00 00 00 02 2F 55
			29 01 00 00 00 00 02 30 00
			29 01 00 00 00 00 02 31 00
			29 01 00 00 00 00 02 32 00
			29 01 00 00 00 00 02 33 A0
			29 01 00 00 00 00 02 34 97
			29 01 00 00 00 00 02 35 A0
			29 01 00 00 00 00 02 36 97
			29 01 00 00 00 00 02 37 14
			29 01 00 00 00 00 02 38 9D
			29 01 00 00 00 00 02 40 11
			29 01 00 00 00 00 02 41 80
			29 01 00 00 00 00 02 42 A0
			29 01 00 00 00 00 02 43 8C
			29 01 00 00 00 00 02 44 A0
			29 01 00 00 00 00 02 45 8C
			29 01 00 00 00 00 02 46 14
			29 01 00 00 00 00 02 47 82
			29 01 00 00 00 00 02 4A 00
			29 01 00 00 00 00 02 4B 05
			29 01 00 00 00 00 02 4C 8C
			29 01 00 00 00 00 02 4F A0
			29 01 00 00 00 00 02 50 97
			29 01 00 00 00 00 02 51 A0
			29 01 00 00 00 00 02 52 97
			29 01 00 00 00 00 02 53 14
			29 01 00 00 00 00 02 54 9D
			29 01 00 00 00 00 02 55 14
			29 01 00 00 00 00 02 56 9D
			29 01 00 00 00 00 02 58 00
			29 01 00 00 00 00 02 59 00
			29 01 00 00 00 00 02 5A 22
			29 01 00 00 00 00 02 5B C0
			29 01 00 00 00 00 02 5C 00
			29 01 00 00 00 00 02 5D 05
			29 01 00 00 00 00 02 5E B0
			29 01 00 00 00 00 02 61 A0
			29 01 00 00 00 00 02 62 97
			29 01 00 00 00 00 02 63 A0
			29 01 00 00 00 00 02 64 97
			29 01 00 00 00 00 02 65 14
			29 01 00 00 00 00 02 66 9D
			29 01 00 00 00 00 02 6B 44
			29 01 00 00 00 00 02 6C 0D
			29 01 00 00 00 00 02 6D 0D
			29 01 00 00 00 00 02 6E 0F
			29 01 00 00 00 00 02 6F 0F
			29 01 00 00 00 00 02 78 00
			29 01 00 00 00 00 02 79 60
			29 01 00 00 00 00 02 7A 00
			29 01 00 00 00 00 02 7B 01
			29 01 00 00 00 00 02 8A 02
			29 01 00 00 00 00 02 CA 1C
			29 01 00 00 00 00 02 CC 1C
			29 01 00 00 00 00 02 CD 00
			29 01 00 00 00 00 02 CE 00
			29 01 00 00 00 00 02 CF 1C
			29 01 00 00 00 00 02 D0 00
			29 01 00 00 00 00 02 D1 00
			29 01 00 00 00 00 02 D3 11
			29 01 00 00 00 00 02 D4 CC
			29 01 00 00 00 00 02 D5 11
			29 01 00 00 0A 00 02 FF 26
			29 01 00 00 00 00 02 FB 01
			29 01 00 00 00 00 02 00 A1
			29 01 00 00 00 00 02 04 4B
			29 01 00 00 00 00 02 0C 0B
			29 01 00 00 00 00 02 0D 01
			29 01 00 00 00 00 02 0E 02
			29 01 00 00 00 00 02 0F 06
			29 01 00 00 00 00 02 10 07
			29 01 00 00 00 00 02 11 00
			29 01 00 00 00 00 02 13 28
			29 01 00 00 00 00 02 14 88
			29 01 00 00 00 00 02 16 81
			29 01 00 00 00 00 02 19 15
			29 01 00 00 00 00 02 1A 0D
			29 01 00 00 00 00 02 1B 12
			29 01 00 00 00 00 02 1C 82
			29 01 00 00 00 00 02 1D 00
			29 01 00 00 00 00 02 1E B1
			29 01 00 00 00 00 02 1F B1
			29 01 00 00 00 00 02 24 01
			29 01 00 00 00 00 02 25 B1
			29 01 00 00 00 00 02 2F 03
			29 01 00 00 00 00 02 30 96
			29 01 00 00 00 00 02 31 11
			29 01 00 00 00 00 02 32 11
			29 01 00 00 00 00 02 34 02
			29 01 00 00 00 00 02 35 B1
			29 01 00 00 00 00 02 36 67
			29 01 00 00 00 00 02 37 11
			29 01 00 00 00 00 02 38 11
			29 01 00 00 00 00 02 3F 04
			29 01 00 00 00 00 02 40 B1
			29 01 00 00 00 00 02 41 00
			29 01 00 00 00 00 02 42 00
			29 01 00 00 00 00 02 49 00
			29 01 00 00 00 00 02 58 D8
			29 01 00 00 00 00 02 59 D8
			29 01 00 00 00 00 02 5A D8
			29 01 00 00 00 00 02 5B D8
			29 01 00 00 00 00 02 5C 01
			29 01 00 00 00 00 02 5D 06
			29 01 00 00 00 00 02 5E 04
			29 01 00 00 00 00 02 5F 00
			29 01 00 00 00 00 02 60 00
			29 01 00 00 00 00 02 61 00
			29 01 00 00 00 00 02 62 00
			29 01 00 00 00 00 02 63 60
			29 01 00 00 00 00 02 64 B0
			29 01 00 00 00 00 02 65 05
			29 01 00 00 00 00 02 66 B0
			29 01 00 00 00 00 02 67 A0
			29 01 00 00 00 00 02 68 97
			29 01 00 00 00 00 02 69 A0
			29 01 00 00 00 00 02 6A 97
			29 01 00 00 00 00 02 6B 00
			29 01 00 00 00 00 02 6C 00
			29 01 00 00 00 00 02 6D 00
			29 01 00 00 00 00 02 70 14
			29 01 00 00 00 00 02 71 9D
			29 01 00 00 00 00 02 73 A0
			29 01 00 00 00 00 02 74 97
			29 01 00 00 00 00 02 75 A0
			29 01 00 00 00 00 02 76 97
			29 01 00 00 00 00 02 77 14
			29 01 00 00 00 00 02 78 9D
			29 01 00 00 00 00 02 7A A0
			29 01 00 00 00 00 02 7B 97
			29 01 00 00 00 00 02 7C A0
			29 01 00 00 00 00 02 7D 97
			29 01 00 00 00 00 02 7E 14
			29 01 00 00 00 00 02 7F 9D
			29 01 00 00 00 00 02 82 60
			29 01 00 00 00 00 02 83 B0
			29 01 00 00 00 00 02 84 05
			29 01 00 00 00 00 02 85 B0
			29 01 00 00 00 00 02 86 A0
			29 01 00 00 00 00 02 87 97
			29 01 00 00 00 00 02 88 A0
			29 01 00 00 00 00 02 89 97
			29 01 00 00 00 00 02 8A 14
			29 01 00 00 00 00 02 8B 9D
			29 01 00 00 00 00 02 8C 00
			29 01 00 00 00 00 02 8D 00
			29 01 00 00 00 00 02 8E 01
			29 01 00 00 00 00 02 8F 00
			29 01 00 00 00 00 02 90 00
			29 01 00 00 00 00 02 91 00
			29 01 00 00 00 00 02 92 05
			29 01 00 00 00 00 02 93 F0
			29 01 00 00 00 00 02 94 00
			29 01 00 00 00 00 02 96 00
			29 01 00 00 00 00 02 99 0D
			29 01 00 00 00 00 02 9A 36
			29 01 00 00 00 00 02 9B 0C
			29 01 00 00 00 00 02 9C 9E
			29 01 00 00 0A 00 02 FF 23
			29 01 00 00 00 00 02 FB 01
			29 01 00 00 00 00 02 12 AB
			29 01 00 00 00 00 02 15 F5
			29 01 00 00 00 00 02 16 0B
			29 01 00 00 0A 00 02 FF 27
			29 01 00 00 00 00 02 FB 01
			29 01 00 00 00 00 02 13 00
			29 01 00 00 00 00 02 96 03
			29 01 00 00 00 00 02 97 11
			29 01 00 00 00 00 02 98 88
			29 01 00 00 00 00 02 99 01
			29 01 00 00 00 00 02 9D 15
			29 01 00 00 00 00 02 9E 55
			29 01 00 00 00 00 02 9F 04
			29 01 00 00 00 00 02 A9 14
			29 01 00 00 00 00 02 AA 0F
			29 01 00 00 00 00 02 AB 14
			29 01 00 00 00 00 02 AC 0F
			29 01 00 00 00 00 02 AD 15
			29 01 00 00 00 00 02 AE 55
			29 01 00 00 00 00 02 AF 04
			29 01 00 00 00 00 02 B0 03
			29 01 00 00 00 00 02 B3 C7
			29 01 00 00 0A 00 02 FF E0
			29 01 00 00 00 00 02 FB 01
			29 01 00 00 00 00 02 9E 00
			29 01 00 00 0A 00 02 FF 10
			29 01 00 00 00 00 02 FB 01
			29 01 00 00 00 00 02 51 FF
			29 01 00 00 00 00 02 53 24
			29 01 00 00 00 00 02 55 00
			29 01 00 00 00 00 02 BA 02
			29 01 00 00 64 00 02 11 00
			29 01 00 00 00 00 02 29 00];
		qcom,mdss-dsi-off-command = [05 01 00 00 32 00 02 28 00
					05 01 00 00 78 00 02 10 00];
		qcom,mdss-dsi-on-command-state = "dsi_lp_mode";
		qcom,mdss-dsi-off-command-state = "dsi_hs_mode";
		qcom,mdss-dsi-h-sync-pulse = <1>;
		qcom,mdss-dsi-traffic-mode = "burst_mode";
		qcom,mdss-dsi-lane-map = "lane_map_012";
		qcom,mdss-dsi-bllp-eof-power-mode;
		qcom,mdss-dsi-bllp-power-mode;
		qcom,mdss-dsi-lane-0-state;
		qcom,mdss-dsi-lane-1-state;
		qcom,mdss-dsi-lane-2-state;
		qcom,mdss-dsi-panel-timings = [8B 1E 14 00 42 46 18 20 19 03 04 00];
		qcom,mdss-dsi-t-clk-post = <0x0B>;
		qcom,mdss-dsi-t-clk-pre = <0x26>;
		qcom,mdss-dsi-bl-min-level = <2>;
		qcom,mdss-dsi-bl-max-level = <2047>;
		qcom,mdss-brightness-max-level = <2047>;
		qcom,mdss-dsi-dma-trigger = "trigger_sw";
		qcom,mdss-dsi-mdp-trigger = "none";
		qcom,mdss-dsi-bl-pmic-control-type = "bl_ctrl_dcs";
		qcom,mdss-dsi-reset-sequence = <1 5>, <0 5>, <1 5>;
		qcom,mdss-dsi-lp11-init;
		qcom,mdss-dsi-init-delay-us = <50000>;
	};
};
