/* Copyright (c) 2013, The Linux Foundation. All rights reserved.
 *
 * This program is free software; you can redistribute it and/or modify
 * it under the terms of the GNU General Public License version 2 and
 * only version 2 as published by the Free Software Foundation.
 *
 * This program is distributed in the hope that it will be useful,
 * but WITHOUT ANY WARRANTY; without even the implied warranty of
 * MERCHANTABILITY or FITNESS FOR A PARTICULAR PURPOSE.  See the
 * GNU General Public License for more details.
 */

/*---------------------------------------------------------------------------
 * This file is autogenerated file using gcdb parser. Please do not edit it.
 * Update input XML file to add a new entry or update variable in this file
 * VERSION = "1.0"
 *---------------------------------------------------------------------------*/
&mdss_mdp {
	dsi_oppo18171auo_hx83112a_720p_video: qcom,mdss_dsi_oppo18171auo_hx83112a_720p_video {
		qcom,mdss-dsi-panel-name = "auo hx83112a 720p video mode dsi panel";
		qcom,mdss-dsi-panel-manufacture = "TRULY_HIMAX";
		qcom,mdss-dsi-panel-version = "hx83112a_QC01";
		qcom,mdss-dsi-panel-controller = <&mdss_dsi0>;
		qcom,mdss-dsi-panel-type = "dsi_video_mode";
		qcom,mdss-dsi-panel-destination = "display_1";
		qcom,mdss-dsi-panel-framerate = <60>;
		qcom,mdss-dsi-panel-clockrate = <720000000>;
		qcom,mdss-dsi-virtual-channel-id = <0>;
		qcom,mdss-dsi-stream = <0>;
		qcom,mdss-dsi-panel-width = <720>;
		qcom,mdss-dsi-panel-height = <1520>;
		qcom,mdss-dsi-h-front-porch = <120>;
		qcom,mdss-dsi-h-back-porch = <88>;
		qcom,mdss-dsi-h-pulse-width = <28>;
		qcom,mdss-dsi-h-sync-skew = <0>;
		qcom,mdss-dsi-v-back-porch = <5>;
		qcom,mdss-dsi-v-front-porch = <40>;
		qcom,mdss-dsi-v-pulse-width = <5>;
		qcom,mdss-dsi-h-left-border = <0>;
		qcom,mdss-dsi-h-right-border = <0>;
		qcom,mdss-dsi-v-top-border = <0>;
		qcom,mdss-dsi-v-bottom-border = <0>;
		qcom,mdss-dsi-bpp = <24>;
		qcom,mdss-dsi-underflow-color = <0xff>;
		qcom,mdss-dsi-border-color = <0>;
		qcom,mdss-dsi-on-command = [29 01 00 00 00 00 04 B9 83 11 2A
					29 01 00 00 00 00 02 BA 72
					29 01 00 00 00 00 09 B1 08 17 17 80 80 4D 4F AA
					29 01 00 00 00 00 0F B2 00 02 00 52 F0 00 08 26 23 11 15 00 11 A3
					29 01 00 00 00 00 1C B4 87 5F 68 07 08 EF 08 E6 08 E6 08 E6 00 FF 00 FF 00 00 0E 0F 00 30 03 07 16 00 30
					29 01 00 00 00 00 07 C7 70 00 04 E0 33 00
					29 01 00 00 00 00 02 E9 C3
					29 01 00 00 00 00 03 CB D2 48
					29 01 00 00 00 00 02 E9 3F
					29 01 00 00 00 00 02 CC 08
					29 01 00 00 00 00 03 D2 2B 2B
					29 01 00 00 00 00 32 D3 C0 00 00 00 00 01 00 08 08 03 03 22 18 07 07 07 07 32 10 06 00 06 32 10 07 00 07 32 15 FD 05 FD 00 00 00 00 00 00 00 08 05 EA 00 00 00 06 0D 2E 08
					29 01 00 00 00 00 31 D5 18 18 18 18 18 18 18 18 C0 C0 18 18 19 19 18 18 40 40 18 18 18 18 3F 3F 28 28 24 24 02 03 02 03 00 01 00 01 31 31 31 31 30 30 30 30 2F 2F 2F 2F
					29 01 00 00 00 00 31 D6 18 18 18 18 18 18 18 18 40 40 18 18 18 18 19 19 40 40 18 18 18 18 3F 3F 24 24 28 28 01 00 01 00 03 02 03 02 31 31 31 31 30 30 30 30 2F 2F 2F 2F
					29 01 00 00 00 00 19 D8 AA EA AA AA AA AA AA EA AA AA AA AA AA EA AB AA AA AA AA EA AB AA AA AA
					29 01 00 00 00 00 18 E7 0E 0E 1E 7B 1D 7B 00 32 60 60 00 00 02 02 02 05 14 14 32 B9 23 B9 08
					29 01 00 00 00 00 02 BD 01
					29 01 00 00 00 00 04 CB 25 11 01
					29 01 00 00 00 00 09 D3 00 00 19 10 00 0A 00 81
					29 01 00 00 00 00 19 D8 AA 2E 28 00 00 00 AA 2E 28 00 00 00 AA EE AA AA AA AA AA EE AA AA AA AA
					29 01 00 00 00 00 09 E7 02 00 68 01 70 0D 50 0E
					29 01 00 00 00 00 02 BD 02
					29 01 00 00 00 00 0A B4 00 92 12 11 88 12 12 00 53
					29 01 00 00 00 00 0D D8 AA FF FF FF FF FF AA FF FF FF FF FF
					29 01 00 00 00 00 1D E7 00 00 08 00 01 00 00 00 00 00 00 00 00 00 00 00 00 00 00 00 00 00 04 00 00 00 00 02
					29 01 00 00 00 00 02 BD 03
					29 01 00 00 00 00 19 D8 AA AA EA AA AA AA AA AA EA AA AA AA AA EF FF FF FF FF AA EF FF FF FF FF
					29 01 00 00 00 00 02 BD 00
					29 01 00 00 00 00 05 C9 04 08 A0 00
					29 01 00 00 00 00 02 E9 C3
					29 01 00 00 00 00 03 CB C2 5F
					29 01 00 00 00 00 02 E9 C3
					29 01 00 00 00 00 03 CB D2 5F
					29 01 00 00 00 00 02 E9 3F
					29 01 00 00 00 00 02 E9 C9
					29 01 00 00 00 00 02 B2 2F
					29 01 00 00 00 00 02 E9 3F
					29 01 00 00 00 00 02 E9 C4
					29 01 00 00 00 00 02 CF C0
					29 01 00 00 00 00 02 E9 3F
					29 01 00 00 05 00 02 55 01
					29 01 00 00 00 00 17 E4 2D 01 2C 00 08 00 10 08 04 04 3F 56 6D 84 9B B2 C9 E0 F2 FF FF EF
					29 01 00 00 05 00 03 51 0F FF
					29 01 00 00 05 00 02 53 24
					29 01 00 00 82 00 02 11 00
					29 01 00 00 3C 00 02 29 00];
		qcom,mdss-dsi-off-command = [05 01 00 00 14 00 02 28 00
					05 01 00 00 50 00 02 10 00];
		qcom,mdss-dsi-on-command-state = "dsi_lp_mode";
		qcom,mdss-dsi-off-command-state = "dsi_lp_mode";
		qcom,mdss-dsi-h-sync-pulse = <1>;
		qcom,mdss-dsi-traffic-mode = "burst_mode";
		qcom,mdss-dsi-lane-map = "lane_map_012";
		qcom,mdss-dsi-bllp-eof-power-mode;
		qcom,mdss-dsi-bllp-power-mode;
		qcom,mdss-dsi-lane-0-state;
		qcom,mdss-dsi-lane-1-state;
		qcom,mdss-dsi-lane-2-state;
		qcom,mdss-dsi-panel-timings = [8B 1E 14 00 42 46 18 20 19 03 04 00];
		qcom,mdss-dsi-t-clk-post = <0x0C>;
		qcom,mdss-dsi-t-clk-pre = <0x29>;
		qcom,mdss-dsi-bl-min-level = <2>;
		qcom,mdss-dsi-bl-max-level = <2047>;
		qcom,mdss-brightness-max-level = <2047>;
		qcom,mdss-dsi-dma-trigger = "trigger_sw";
		qcom,mdss-dsi-mdp-trigger = "none";
		qcom,mdss-dsi-bl-pmic-control-type = "bl_ctrl_dcs";
		qcom,mdss-dsi-reset-sequence = <1 5>, <0 5>, <1 55>;
		qcom,mdss-dsi-lp11-init;
		qcom,mdss-dsi-init-delay-us = <10000>;
		qcom,mdss-pan-physical-width-dimension = <67>;
		qcom,mdss-pan-physical-height-dimension = <143>;
		qcom,esd-check-enabled;
		qcom,mdss-dsi-panel-status-read-length = <1>;
		qcom,mdss-dsi-panel-status-check-mode="reg_read";
		qcom,mdss-dsi-panel-status-command = [14 01 00 01 05 00 02 0A 08];
		qcom,mdss-dsi-panel-status-command-state = "dsi_lp_mode";
		qcom,mdss-dsi-panel-status-value = <0x9D>;
		qcom,mdss-dsi-cabc-off-command = [
                15 01 00 00 00 00 02 53 2C
                15 01 00 00 00 00 02 55 00];
		qcom,mdss-dsi-cabc-ui-command = [
                15 01 00 00 00 00 02 53 2C
                15 01 00 00 00 00 02 55 01];
		qcom,mdss-dsi-cabc-image-command = [
                15 01 00 00 00 00 02 53 2C
                15 01 00 00 00 00 02 55 01];
		qcom,mdss-dsi-cabc-video-command = [
                15 01 00 00 00 00 02 53 2C
                15 01 00 00 00 00 02 55 01];
	};
};
