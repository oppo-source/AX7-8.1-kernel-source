/* Copyright (c) 2013, The Linux Foundation. All rights reserved.
 *
 * This program is free software; you can redistribute it and/or modify
 * it under the terms of the GNU General Public License version 2 and
 * only version 2 as published by the Free Software Foundation.
 *
 * This program is distributed in the hope that it will be useful,
 * but WITHOUT ANY WARRANTY; without even the implied warranty of
 * MERCHANTABILITY or FITNESS FOR A PARTICULAR PURPOSE.  See the
 * GNU General Public License for more details.
 */

/*---------------------------------------------------------------------------
 * This file is autogenerated file using gcdb parser. Please do not edit it.
 * Update input XML file to add a new entry or update variable in this file
 * VERSION = "1.0"
 *---------------------------------------------------------------------------*/
&mdss_mdp {
	dsi_oppo18171hlt_lsi7at0_720p_video: qcom,mdss_dsi_oppo18171hlt_lsi7at0_720p_video {
		qcom,mdss-dsi-panel-name = "hlt lsi7at0 720p video mode dsi panel";
		qcom,mdss-dsi-panel-manufacture = "HLT_LSI";
		qcom,mdss-dsi-panel-version = "lsi7at0_QC01";
		qcom,mdss-dsi-panel-controller = <&mdss_dsi0>;
		qcom,mdss-dsi-panel-type = "dsi_video_mode";
		qcom,mdss-dsi-panel-destination = "display_1";
		qcom,mdss-dsi-panel-framerate = <60>;
		qcom,mdss-dsi-panel-clockrate = <720000000>;
		qcom,mdss-dsi-virtual-channel-id = <0>;
		qcom,mdss-dsi-stream = <0>;
		qcom,mdss-dsi-panel-width = <720>;
		qcom,mdss-dsi-panel-height = <1520>;
		qcom,mdss-dsi-h-front-porch = <65>;
		qcom,mdss-dsi-h-back-porch = <8>;
		qcom,mdss-dsi-h-pulse-width = <8>;
		qcom,mdss-dsi-h-sync-skew = <0>;
		qcom,mdss-dsi-v-back-porch = <96>;
		qcom,mdss-dsi-v-front-porch = <251>;
		qcom,mdss-dsi-v-pulse-width = <8>;
		qcom,mdss-dsi-h-left-border = <0>;
		qcom,mdss-dsi-h-right-border = <0>;
		qcom,mdss-dsi-v-top-border = <0>;
		qcom,mdss-dsi-v-bottom-border = <0>;
		qcom,mdss-dsi-bpp = <24>;
		qcom,mdss-dsi-underflow-color = <0xff>;
		qcom,mdss-dsi-border-color = <0>;
		qcom,mdss-dsi-on-command = [29 01 00 00 00 00 03 F0 5A 5A
				29 01 00 00 00 00 03 F1 5A 5A
				29 01 00 00 00 00 03 FC 5A 5A
				29 01 00 00 00 00 18 C8 00 24 00 41 3A 00 00 00 15 F0 64 00 00 85 48 0F 00 00 00 00 20 40 40
				29 01 00 00 00 00 47 ED 30 40 6F 6F 33 60 80 31 40 6F 6F 33 40 80 32 40 6F 6F 33 20 80 33 40 6F 6F 33 00 80 10 69 00 00 00 80 90 10 49 00 00 00 A0 A0 40 41 93 7D 00 E0 20 41 41 93 7D 00 C0 20 40 48 92 08 40 40 80 8C 3F 30 00 00 00 00
				29 01 00 00 00 00 4A EE 33 08 6F 6F 33 04 00 00 E5 33 09 6F 6F 33 04 00 00 C6 33 0A 6F 6F 33 04 00 00 A7 33 0B 6F 6F 33 04 00 00 88 33 04 6F 6F 33 04 00 00 61 33 05 6F 6F 33 04 00 00 42 33 06 6F 6F 33 04 00 00 23 33 07 6F 6F 33 04 00 00 04 FF
				29 01 00 00 00 00 02 B0 02
				29 01 00 00 00 00 02 F4 18
				29 01 00 00 00 00 10 C0 23 00 F9 01 00 FF 00 04 0F FF 70 40 86 DA 8E
				29 01 00 00 00 00 25 C1 CD C0 B9 25 66 6D 6F 74 78 82 8F 98 9D A1 A2 A7 AA B1 D0 FF 88 96 A5 B4 BE C8 CD D0 D3 D7 DF E6 EA F0 F5 FF
				29 01 00 00 00 00 02 73 B4
				29 01 00 00 00 00 03 F0 A5 A5
				29 01 00 00 00 00 03 F1 A5 A5
				29 01 00 00 00 00 03 FC A5 A5
				29 01 00 00 00 00 03 51 FF F1
				29 01 00 00 00 00 02 53 24
				29 01 00 00 00 00 02 55 01
				29 01 00 00 64 00 02 11 00
				29 01 00 00 14 00 02 29 00];
		qcom,mdss-dsi-off-command = [05 01 00 00 24 00 02 28 00
					05 01 00 00 64 00 02 10 00
					29 01 00 00 00 00 03 F0 5A 5A
					29 01 00 00 64 00 02 4F 01
					29 01 00 00 00 00 03 F0 A5 A5];
		qcom,mdss-dsi-off-gesture-command = [05 01 00 00 24 00 02 28 00
					05 01 00 00 64 00 02 10 00
					05 01 00 00 0A 00 02 24 00];
		qcom,mdss-dsi-on-command-state = "dsi_lp_mode";
		qcom,mdss-dsi-off-command-state = "dsi_lp_mode";
		qcom,mdss-dsi-h-sync-pulse = <1>;
		qcom,mdss-dsi-traffic-mode = "burst_mode";
		qcom,mdss-dsi-lane-map = "lane_map_012";
		qcom,mdss-dsi-bllp-eof-power-mode;
		qcom,mdss-dsi-bllp-power-mode;
		qcom,mdss-dsi-force-clock-lane-hs;
		qcom,mdss-dsi-lane-0-state;
		qcom,mdss-dsi-lane-1-state;
		qcom,mdss-dsi-lane-2-state;
		qcom,mdss-dsi-panel-timings = [8B 1E 14 00 42 46 18 20 19 03 04 00];
		qcom,mdss-dsi-t-clk-post = <0x0C>;
		qcom,mdss-dsi-t-clk-pre = <0x29>;
		qcom,mdss-dsi-bl-min-level = <2>;
		qcom,mdss-dsi-bl-max-level = <2047>;
		qcom,mdss-brightness-max-level = <2047>;
		qcom,mdss-dsi-dma-trigger = "trigger_sw";
		qcom,mdss-dsi-mdp-trigger = "none";
		qcom,mdss-dsi-bl-pmic-control-type = "bl_ctrl_dcs";
		qcom,mdss-dsi-reset-sequence = <1 15>, <0 5>, <1 15>;
		qcom,mdss-dsi-lp11-init;
		qcom,mdss-dsi-init-delay-us = <10000>;
		qcom,mdss-pan-physical-width-dimension = <67>;
		qcom,mdss-pan-physical-height-dimension = <143>;
		qcom,esd-check-enabled;
		qcom,mdss-dsi-panel-status-read-length = <1>;
		qcom,mdss-dsi-panel-status-check-mode="reg_read";
		qcom,mdss-dsi-panel-status-command = [06 01 00 01 05 00 02 0A 08];
		qcom,mdss-dsi-panel-status-command-state = "dsi_lp_mode";
		qcom,mdss-dsi-panel-status-value = <0x9C>;

		qcom,mdss-dsi-lsi-tp-watchdog-on-command = [29 01 00 00 00 00 03 F0 5A 5A
					29 01 00 00 00 00 02 73 B4
					29 01 00 00 00 00 03 F0 A5 A5];
		qcom,mdss-dsi-lsi-tp-watchdog-off-command = [29 01 00 00 00 00 03 F0 5A 5A
					29 01 00 00 00 00 02 73 B0
					29 01 00 00 00 00 03 F0 A5 A5];

		qcom,mdss-dsi-cabc-off-command = [
                15 01 00 00 00 00 02 53 2C
                15 01 00 00 00 00 02 55 00];
		qcom,mdss-dsi-cabc-ui-command = [
                15 01 00 00 00 00 02 53 2C
                15 01 00 00 00 00 02 55 01];
		qcom,mdss-dsi-cabc-image-command = [
                15 01 00 00 00 00 02 53 2C
                15 01 00 00 00 00 02 55 01];
		qcom,mdss-dsi-cabc-video-command = [
                15 01 00 00 00 00 02 53 2C
                15 01 00 00 00 00 02 55 01];
	};
};
