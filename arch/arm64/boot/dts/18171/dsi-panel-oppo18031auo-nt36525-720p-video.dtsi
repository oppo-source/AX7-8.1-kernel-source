/* Copyright (c) 2013, The Linux Foundation. All rights reserved.
 *
 * This program is free software; you can redistribute it and/or modify
 * it under the terms of the GNU General Public License version 2 and
 * only version 2 as published by the Free Software Foundation.
 *
 * This program is distributed in the hope that it will be useful,
 * but WITHOUT ANY WARRANTY; without even the implied warranty of
 * MERCHANTABILITY or FITNESS FOR A PARTICULAR PURPOSE.  See the
 * GNU General Public License for more details.
 */

/*---------------------------------------------------------------------------
 * This file is autogenerated file using gcdb parser. Please do not edit it.
 * Update input XML file to add a new entry or update variable in this file
 * VERSION = "1.0"
 *---------------------------------------------------------------------------*/
&mdss_mdp {
	dsi_oppo18031auo_nt36525_720p_video: qcom,mdss_dsi_oppo18031auo_nt36525_720p_video {
		qcom,mdss-dsi-panel-name = "auo nt36525 720p video mode dsi panel";
		qcom,mdss-dsi-panel-manufacture = "TRULY";
		qcom,mdss-dsi-panel-version = "nt36525";
		qcom,mdss-dsi-panel-controller = <&mdss_dsi0>;
		qcom,mdss-dsi-panel-type = "dsi_video_mode";
		qcom,mdss-dsi-panel-destination = "display_1";
		qcom,mdss-dsi-panel-framerate = <60>;
		qcom,mdss-dsi-panel-clockrate = <720000000>;
		qcom,mdss-dsi-virtual-channel-id = <0>;
		qcom,mdss-dsi-stream = <0>;
		qcom,mdss-dsi-panel-width = <720>;
		qcom,mdss-dsi-panel-height = <1520>;
		qcom,mdss-dsi-h-front-porch = <200>;
		qcom,mdss-dsi-h-back-porch = <38>;
		qcom,mdss-dsi-h-pulse-width = <20>;
		qcom,mdss-dsi-h-sync-skew = <0>;
		qcom,mdss-dsi-v-back-porch = <4>;
		qcom,mdss-dsi-v-front-porch = <8>;
		qcom,mdss-dsi-v-pulse-width = <2>;
		qcom,mdss-dsi-h-left-border = <0>;
		qcom,mdss-dsi-h-right-border = <0>;
		qcom,mdss-dsi-v-top-border = <0>;
		qcom,mdss-dsi-v-bottom-border = <0>;
		qcom,mdss-dsi-bpp = <24>;
		qcom,mdss-dsi-underflow-color = <0xff>;
		qcom,mdss-dsi-border-color = <0>;
		qcom,mdss-dsi-on-command = [29 01 00 00 00 00 02 FF 20
				29 01 00 00 00 00 02 FB 01
				29 01 00 00 00 00 02 05 A9
				29 01 00 00 00 00 02 0E 87
				29 01 00 00 00 00 02 0F 55
				29 01 00 00 00 00 02 1F 00
				29 01 00 00 00 00 02 69 A9
				29 01 00 00 00 00 02 95 B9
				29 01 00 00 00 00 02 96 CD
				29 01 00 00 00 00 02 FF 23
				29 01 00 00 00 00 02 FB 01
				29 01 00 00 00 00 02 00 60
				29 01 00 00 00 00 02 05 24
				29 01 00 00 00 00 02 07 00
				29 01 00 00 00 00 02 12 AB
				29 01 00 00 00 00 02 15 F5
				29 01 00 00 00 00 02 16 0B
				29 01 00 00 00 00 02 45 FF
				29 01 00 00 00 00 02 46 FB
				29 01 00 00 00 00 02 47 F3
				29 01 00 00 00 00 02 48 EB
				29 01 00 00 00 00 02 49 E3
				29 01 00 00 00 00 02 4A DD
				29 01 00 00 00 00 02 4B D7
				29 01 00 00 00 00 02 4C D1
				29 01 00 00 00 00 02 4D CB
				29 01 00 00 00 00 02 4E C5
				29 01 00 00 00 00 02 4F BF
				29 01 00 00 00 00 02 50 B9
				29 01 00 00 00 00 02 51 B3
				29 01 00 00 00 00 02 52 AD
				29 01 00 00 00 00 02 53 A7
				29 01 00 00 00 00 02 54 A1
				29 01 00 00 00 00 02 FF 24
				29 01 00 00 00 00 02 FB 01
				29 01 00 00 00 00 02 00 20
				29 01 00 00 00 00 02 01 20
				29 01 00 00 00 00 02 02 05
				29 01 00 00 00 00 02 03 05
				29 01 00 00 00 00 02 04 9F
				29 01 00 00 00 00 02 05 9F
				29 01 00 00 00 00 02 06 9E
				29 01 00 00 00 00 02 07 9E
				29 01 00 00 00 00 02 08 0C
				29 01 00 00 00 00 02 09 03
				29 01 00 00 00 00 02 0A 0D
				29 01 00 00 00 00 02 0B 0E
				29 01 00 00 00 00 02 0C 0F
				29 01 00 00 00 00 02 0D 10
				29 01 00 00 00 00 02 0E 11
				29 01 00 00 00 00 02 0F 12
				29 01 00 00 00 00 02 10 13
				29 01 00 00 00 00 02 11 04
				29 01 00 00 00 00 02 12 04
				29 01 00 00 00 00 02 13 20
				29 01 00 00 00 00 02 14 20
				29 01 00 00 00 00 02 15 20
				29 01 00 00 00 00 02 16 20
				29 01 00 00 00 00 02 17 20
				29 01 00 00 00 00 02 18 05
				29 01 00 00 00 00 02 19 05
				29 01 00 00 00 00 02 1A 9F
				29 01 00 00 00 00 02 1B 9F
				29 01 00 00 00 00 02 1C 9E
				29 01 00 00 00 00 02 1D 9E
				29 01 00 00 00 00 02 1E 0C
				29 01 00 00 00 00 02 1F 03
				29 01 00 00 00 00 02 20 0D
				29 01 00 00 00 00 02 21 0E
				29 01 00 00 00 00 02 22 0F
				29 01 00 00 00 00 02 23 10
				29 01 00 00 00 00 02 24 11
				29 01 00 00 00 00 02 25 12
				29 01 00 00 00 00 02 26 13
				29 01 00 00 00 00 02 27 04
				29 01 00 00 00 00 02 28 04
				29 01 00 00 00 00 02 29 20
				29 01 00 00 00 00 02 2A 20
				29 01 00 00 00 00 02 2B 20
				29 01 00 00 00 00 02 2F 0C
				29 01 00 00 00 00 02 30 40
				29 01 00 00 00 00 02 33 40
				29 01 00 00 00 00 02 34 0C
				29 01 00 00 00 00 02 37 77
				29 01 00 00 00 00 02 3A 9A
				29 01 00 00 00 00 02 3B 95
				29 01 00 00 00 00 02 3D 92
				29 01 00 00 00 00 02 4D 15
				29 01 00 00 00 00 02 4E 26
				29 01 00 00 00 00 02 4F 37
				29 01 00 00 00 00 02 50 48
				29 01 00 00 00 00 02 51 84
				29 01 00 00 00 00 02 52 73
				29 01 00 00 00 00 02 53 62
				29 01 00 00 00 00 02 54 51
				29 01 00 00 00 00 02 55 86
				29 01 00 00 00 00 02 56 78
				29 01 00 00 00 00 02 5A 9A
				29 01 00 00 00 00 02 5B 95
				29 01 00 00 00 00 02 5C 8F
				29 01 00 00 00 00 02 5D 0A
				29 01 00 00 00 00 02 5E 10
				29 01 00 00 00 00 02 60 80
				29 01 00 00 00 00 02 61 7C
				29 01 00 00 00 00 02 64 11
				29 01 00 00 00 00 02 85 11
				29 01 00 00 00 00 02 92 AD
				29 01 00 00 00 00 02 93 08
				29 01 00 00 00 00 02 94 06
				29 01 00 00 00 00 02 AB 00
				29 01 00 00 00 00 02 AD 00
				29 01 00 00 00 00 02 B0 05
				29 01 00 00 00 00 02 B1 A9
				29 01 00 00 00 00 02 FF 25
				29 01 00 00 00 00 02 FB 01
				29 01 00 00 00 00 02 0A 82
				29 01 00 00 00 00 02 0B 9C
				29 01 00 00 00 00 02 0C 01
				29 01 00 00 00 00 02 17 82
				29 01 00 00 00 00 02 18 06
				29 01 00 00 00 00 02 19 0F
				29 01 00 00 00 00 02 1F 9A
				29 01 00 00 00 00 02 20 95
				29 01 00 00 00 00 02 23 05
				29 01 00 00 00 00 02 24 A9
				29 01 00 00 00 00 02 26 9A
				29 01 00 00 00 00 02 27 95
				29 01 00 00 00 00 02 2A 05
				29 01 00 00 00 00 02 2B A9
				29 01 00 00 00 00 02 2F 80
				29 01 00 00 00 00 02 40 10
				29 01 00 00 00 00 02 41 80
				29 01 00 00 00 00 02 42 A6
				29 01 00 00 00 00 02 43 95
				29 01 00 00 00 00 02 46 05
				29 01 00 00 00 00 02 47 A9
				29 01 00 00 00 00 02 4C 95
				29 01 00 00 00 00 02 4E 95
				29 01 00 00 00 00 02 4F A6
				29 01 00 00 00 00 02 50 95
				29 01 00 00 00 00 02 53 05
				29 01 00 00 00 00 02 54 A9
				29 01 00 00 00 00 02 55 05
				29 01 00 00 00 00 02 56 A9
				29 01 00 00 00 00 02 5A 80
				29 01 00 00 00 00 02 5B 80
				29 01 00 00 00 00 02 5D 9A
				29 01 00 00 00 00 02 5E 95
				29 01 00 00 00 00 02 5F 9A
				29 01 00 00 00 00 02 60 95
				29 01 00 00 00 00 02 61 9A
				29 01 00 00 00 00 02 62 95
				29 01 00 00 00 00 02 65 05
				29 01 00 00 00 00 02 66 A9
				29 01 00 00 00 00 02 D5 66
				29 01 00 00 00 00 02 FF 26
				29 01 00 00 00 00 02 FB 01
				29 01 00 00 00 00 02 04 42
				29 01 00 00 00 00 02 06 FF
				29 01 00 00 00 00 02 0C 0B
				29 01 00 00 00 00 02 0D 01
				29 01 00 00 00 00 02 0E 02
				29 01 00 00 00 00 02 0F 06
				29 01 00 00 00 00 02 10 07
				29 01 00 00 00 00 02 13 24
				29 01 00 00 00 00 02 14 88
				29 01 00 00 00 00 02 16 81
				29 01 00 00 00 00 02 19 1A
				29 01 00 00 00 00 02 1A 0D
				29 01 00 00 00 00 02 1B 12
				29 01 00 00 00 00 02 1C 82
				29 01 00 00 00 00 02 1E AD
				29 01 00 00 00 00 02 1F AD
				29 01 00 00 00 00 02 24 00
				29 01 00 00 00 00 02 2F 04
				29 01 00 00 00 00 02 30 AD
				29 01 00 00 00 00 02 31 11
				29 01 00 00 00 00 02 32 11
				29 01 00 00 00 00 02 34 04
				29 01 00 00 00 00 02 35 AD
				29 01 00 00 00 00 02 36 81
				29 01 00 00 00 00 02 37 67
				29 01 00 00 00 00 02 38 11
				29 01 00 00 00 00 02 3F 10
				29 01 00 00 00 00 02 40 AD
				29 01 00 00 00 00 02 58 D6
				29 01 00 00 00 00 02 59 D6
				29 01 00 00 00 00 02 5A D6
				29 01 00 00 00 00 02 5B AD
				29 01 00 00 00 00 02 5C 00
				29 01 00 00 00 00 02 5D 26
				29 01 00 00 00 00 02 5E 10
				29 01 00 00 00 00 02 63 9A
				29 01 00 00 00 00 02 64 95
				29 01 00 00 00 00 02 65 9A
				29 01 00 00 00 00 02 66 95
				29 01 00 00 00 00 02 67 9A
				29 01 00 00 00 00 02 68 95
				29 01 00 00 00 00 02 6B 00
				29 01 00 00 00 00 02 6D 00
				29 01 00 00 00 00 02 70 05
				29 01 00 00 00 00 02 71 D2
				29 01 00 00 00 00 02 73 9A
				29 01 00 00 00 00 02 74 95
				29 01 00 00 00 00 02 77 05
				29 01 00 00 00 00 02 78 D2
				29 01 00 00 00 00 02 7A 9A
				29 01 00 00 00 00 02 7B 95
				29 01 00 00 00 00 02 7E 05
				29 01 00 00 00 00 02 7F D2
				29 01 00 00 00 00 02 82 9A
				29 01 00 00 00 00 02 83 95
				29 01 00 00 00 00 02 84 9A
				29 01 00 00 00 00 02 85 95
				29 01 00 00 00 00 02 86 9A
				29 01 00 00 00 00 02 87 95
				29 01 00 00 00 00 02 8A 05
				29 01 00 00 00 00 02 8B A9
				29 01 00 00 00 00 02 8F 00
				29 01 00 00 00 00 02 90 00
				29 01 00 00 00 00 02 92 05
				29 01 00 00 00 00 02 93 F0
				29 01 00 00 00 00 02 99 0D
				29 01 00 00 00 00 02 9A 36
				29 01 00 00 00 00 02 9B 0C
				29 01 00 00 00 00 02 9C 9E
				29 01 00 00 00 00 02 FF 27
				29 01 00 00 00 00 02 FB 01
				29 01 00 00 00 00 02 13 00
				29 01 00 00 00 00 02 14 55
				29 01 00 00 00 00 02 FF E0
				29 01 00 00 00 00 02 FB 01
				29 01 00 00 00 00 02 9E 00
				29 01 00 00 00 00 02 FF 10
				29 01 00 00 00 00 02 FB 01
				29 01 00 00 00 00 02 B0 01
				29 01 00 00 00 00 02 BA 02
				29 01 00 00 00 00 03 51 07 FF
				29 01 00 00 00 00 02 53 24
				29 01 00 00 00 00 02 55 00
				29 01 00 00 05 00 02 29 00
				29 01 00 00 66 00 02 11 00];
		qcom,mdss-dsi-pwm-on-command = [29 01 00 00 00 00 02 FF 20
				29 01 00 00 00 00 02 FB 01
				29 01 00 00 00 00 02 05 A9
				29 01 00 00 00 00 02 0E 87
				29 01 00 00 00 00 02 0F 55
				29 01 00 00 00 00 02 1F 00
				29 01 00 00 00 00 02 69 A9
				29 01 00 00 00 00 02 95 E1
				29 01 00 00 00 00 02 96 F5
				29 01 00 00 00 00 02 FF 23
				29 01 00 00 00 00 02 FB 01
				29 01 00 00 00 00 02 00 60
				29 01 00 00 00 00 02 07 00
				29 01 00 00 00 00 02 12 AB
				29 01 00 00 00 00 02 15 F5
				29 01 00 00 00 00 02 16 0B
				29 01 00 00 00 00 02 FF 24
				29 01 00 00 00 00 02 FB 01
				29 01 00 00 00 00 02 00 20
				29 01 00 00 00 00 02 01 20
				29 01 00 00 00 00 02 02 05
				29 01 00 00 00 00 02 03 05
				29 01 00 00 00 00 02 04 9F
				29 01 00 00 00 00 02 05 9F
				29 01 00 00 00 00 02 06 9E
				29 01 00 00 00 00 02 07 9E
				29 01 00 00 00 00 02 08 0C
				29 01 00 00 00 00 02 09 03
				29 01 00 00 00 00 02 0A 0D
				29 01 00 00 00 00 02 0B 0E
				29 01 00 00 00 00 02 0C 0F
				29 01 00 00 00 00 02 0D 10
				29 01 00 00 00 00 02 0E 11
				29 01 00 00 00 00 02 0F 12
				29 01 00 00 00 00 02 10 13
				29 01 00 00 00 00 02 11 04
				29 01 00 00 00 00 02 12 04
				29 01 00 00 00 00 02 13 20
				29 01 00 00 00 00 02 14 20
				29 01 00 00 00 00 02 15 20
				29 01 00 00 00 00 02 16 20
				29 01 00 00 00 00 02 17 20
				29 01 00 00 00 00 02 18 05
				29 01 00 00 00 00 02 19 05
				29 01 00 00 00 00 02 1A 9F
				29 01 00 00 00 00 02 1B 9F
				29 01 00 00 00 00 02 1C 9E
				29 01 00 00 00 00 02 1D 9E
				29 01 00 00 00 00 02 1E 0C
				29 01 00 00 00 00 02 1F 03
				29 01 00 00 00 00 02 20 0D
				29 01 00 00 00 00 02 21 0E
				29 01 00 00 00 00 02 22 0F
				29 01 00 00 00 00 02 23 10
				29 01 00 00 00 00 02 24 11
				29 01 00 00 00 00 02 25 12
				29 01 00 00 00 00 02 26 13
				29 01 00 00 00 00 02 27 04
				29 01 00 00 00 00 02 28 04
				29 01 00 00 00 00 02 29 20
				29 01 00 00 00 00 02 2A 20
				29 01 00 00 00 00 02 2B 20
				29 01 00 00 00 00 02 2F 0C
				29 01 00 00 00 00 02 30 40
				29 01 00 00 00 00 02 33 40
				29 01 00 00 00 00 02 34 0C
				29 01 00 00 00 00 02 37 77
				29 01 00 00 00 00 02 3A 9A
				29 01 00 00 00 00 02 3B 95
				29 01 00 00 00 00 02 3D 92
				29 01 00 00 00 00 02 4D 15
				29 01 00 00 00 00 02 4E 26
				29 01 00 00 00 00 02 4F 37
				29 01 00 00 00 00 02 50 48
				29 01 00 00 00 00 02 51 84
				29 01 00 00 00 00 02 52 73
				29 01 00 00 00 00 02 53 62
				29 01 00 00 00 00 02 54 51
				29 01 00 00 00 00 02 55 86
				29 01 00 00 00 00 02 56 78
				29 01 00 00 00 00 02 5A 9A
				29 01 00 00 00 00 02 5B 95
				29 01 00 00 00 00 02 5C 8F
				29 01 00 00 00 00 02 5D 0A
				29 01 00 00 00 00 02 5E 10
				29 01 00 00 00 00 02 60 80
				29 01 00 00 00 00 02 61 7C
				29 01 00 00 00 00 02 64 11
				29 01 00 00 00 00 02 85 11
				29 01 00 00 00 00 02 92 AD
				29 01 00 00 00 00 02 93 08
				29 01 00 00 00 00 02 94 06
				29 01 00 00 00 00 02 AB 00
				29 01 00 00 00 00 02 AD 00
				29 01 00 00 00 00 02 B0 05
				29 01 00 00 00 00 02 B1 A9
				29 01 00 00 00 00 02 FF 25
				29 01 00 00 00 00 02 FB 01
				29 01 00 00 00 00 02 0A 82
				29 01 00 00 00 00 02 0B 9C
				29 01 00 00 00 00 02 0C 01
				29 01 00 00 00 00 02 17 82
				29 01 00 00 00 00 02 18 06
				29 01 00 00 00 00 02 19 0F
				29 01 00 00 00 00 02 1F 9A
				29 01 00 00 00 00 02 20 95
				29 01 00 00 00 00 02 23 05
				29 01 00 00 00 00 02 24 A9
				29 01 00 00 00 00 02 26 9A
				29 01 00 00 00 00 02 27 95
				29 01 00 00 00 00 02 2A 05
				29 01 00 00 00 00 02 2B A9
				29 01 00 00 00 00 02 2F 80
				29 01 00 00 00 00 02 40 10
				29 01 00 00 00 00 02 41 80
				29 01 00 00 00 00 02 42 A6
				29 01 00 00 00 00 02 43 95
				29 01 00 00 00 00 02 46 05
				29 01 00 00 00 00 02 47 A9
				29 01 00 00 00 00 02 4C 95
				29 01 00 00 00 00 02 4E 95
				29 01 00 00 00 00 02 4F A6
				29 01 00 00 00 00 02 50 95
				29 01 00 00 00 00 02 53 05
				29 01 00 00 00 00 02 54 A9
				29 01 00 00 00 00 02 55 05
				29 01 00 00 00 00 02 56 A9
				29 01 00 00 00 00 02 5A 80
				29 01 00 00 00 00 02 5B 80
				29 01 00 00 00 00 02 5D 9A
				29 01 00 00 00 00 02 5E 95
				29 01 00 00 00 00 02 5F 9A
				29 01 00 00 00 00 02 60 95
				29 01 00 00 00 00 02 61 9A
				29 01 00 00 00 00 02 62 95
				29 01 00 00 00 00 02 65 05
				29 01 00 00 00 00 02 66 A9
				29 01 00 00 00 00 02 D5 66
				29 01 00 00 00 00 02 FF 26
				29 01 00 00 00 00 02 FB 01
				29 01 00 00 00 00 02 04 42
				29 01 00 00 00 00 02 06 FF
				29 01 00 00 00 00 02 0C 0B
				29 01 00 00 00 00 02 0D 01
				29 01 00 00 00 00 02 0E 02
				29 01 00 00 00 00 02 0F 06
				29 01 00 00 00 00 02 10 07
				29 01 00 00 00 00 02 13 24
				29 01 00 00 00 00 02 14 88
				29 01 00 00 00 00 02 16 81
				29 01 00 00 00 00 02 19 1A
				29 01 00 00 00 00 02 1A 0D
				29 01 00 00 00 00 02 1B 12
				29 01 00 00 00 00 02 1C 82
				29 01 00 00 00 00 02 1E AD
				29 01 00 00 00 00 02 1F AD
				29 01 00 00 00 00 02 24 00
				29 01 00 00 00 00 02 2F 04
				29 01 00 00 00 00 02 30 AD
				29 01 00 00 00 00 02 31 11
				29 01 00 00 00 00 02 32 11
				29 01 00 00 00 00 02 34 04
				29 01 00 00 00 00 02 35 AD
				29 01 00 00 00 00 02 36 81
				29 01 00 00 00 00 02 37 67
				29 01 00 00 00 00 02 38 11
				29 01 00 00 00 00 02 3F 10
				29 01 00 00 00 00 02 40 AD
				29 01 00 00 00 00 02 58 D6
				29 01 00 00 00 00 02 59 D6
				29 01 00 00 00 00 02 5A D6
				29 01 00 00 00 00 02 5B AD
				29 01 00 00 00 00 02 5C 00
				29 01 00 00 00 00 02 5D 26
				29 01 00 00 00 00 02 5E 10
				29 01 00 00 00 00 02 63 9A
				29 01 00 00 00 00 02 64 95
				29 01 00 00 00 00 02 65 9A
				29 01 00 00 00 00 02 66 95
				29 01 00 00 00 00 02 67 9A
				29 01 00 00 00 00 02 68 95
				29 01 00 00 00 00 02 6B 00
				29 01 00 00 00 00 02 6D 00
				29 01 00 00 00 00 02 70 05
				29 01 00 00 00 00 02 71 D2
				29 01 00 00 00 00 02 73 9A
				29 01 00 00 00 00 02 74 95
				29 01 00 00 00 00 02 77 05
				29 01 00 00 00 00 02 78 D2
				29 01 00 00 00 00 02 7A 9A
				29 01 00 00 00 00 02 7B 95
				29 01 00 00 00 00 02 7E 05
				29 01 00 00 00 00 02 7F D2
				29 01 00 00 00 00 02 82 9A
				29 01 00 00 00 00 02 83 95
				29 01 00 00 00 00 02 84 9A
				29 01 00 00 00 00 02 85 95
				29 01 00 00 00 00 02 86 9A
				29 01 00 00 00 00 02 87 95
				29 01 00 00 00 00 02 8A 05
				29 01 00 00 00 00 02 8B A9
				29 01 00 00 00 00 02 8F 00
				29 01 00 00 00 00 02 90 00
				29 01 00 00 00 00 02 92 05
				29 01 00 00 00 00 02 93 F0
				29 01 00 00 00 00 02 99 0D
				29 01 00 00 00 00 02 9A 36
				29 01 00 00 00 00 02 9B 0C
				29 01 00 00 00 00 02 9C 9E
				29 01 00 00 00 00 02 FF 27
				29 01 00 00 00 00 02 FB 01
				29 01 00 00 00 00 02 13 00
				29 01 00 00 00 00 02 14 55
				29 01 00 00 00 00 02 FF E0
				29 01 00 00 00 00 02 FB 01
				29 01 00 00 00 00 02 9E 00
				29 01 00 00 00 00 02 FF 10
				29 01 00 00 00 00 02 FB 01
				29 01 00 00 00 00 02 B0 01
				29 01 00 00 00 00 02 BA 02
				29 01 00 00 00 00 03 51 00 00
				29 01 00 00 00 00 02 53 24
				29 01 00 00 00 00 02 55 00
				29 01 00 00 05 00 02 29 00
				29 01 00 00 66 00 02 11 00];
		qcom,mdss-dsi-off-command = [05 01 00 00 05 00 02 28 00
					05 01 00 00 44 00 02 10 00];
		qcom,mdss-dsi-on-command-state = "dsi_lp_mode";
		qcom,mdss-dsi-off-command-state = "dsi_lp_mode";
		qcom,mdss-dsi-h-sync-pulse = <1>;
		qcom,mdss-dsi-traffic-mode = "burst_mode";
		qcom,mdss-dsi-lane-map = "lane_map_012";
		qcom,mdss-dsi-bllp-eof-power-mode;
		qcom,mdss-dsi-bllp-power-mode;
		qcom,mdss-dsi-hfp-power-mode;
		qcom,mdss-dsi-lane-0-state;
		qcom,mdss-dsi-lane-1-state;
		qcom,mdss-dsi-lane-2-state;
		qcom,mdss-dsi-panel-timings = [8B 1E 14 00 42 46 18 20 19 03 04 00];
		qcom,mdss-dsi-t-clk-post = <0x01>;
		qcom,mdss-dsi-t-clk-pre = <0x29>;
		qcom,mdss-dsi-bl-min-level = <2>;
		qcom,mdss-dsi-bl-max-level = <2047>;
		qcom,mdss-brightness-max-level = <2047>;
		qcom,mdss-dsi-dma-trigger = "trigger_sw";
		qcom,mdss-dsi-mdp-trigger = "none";
		qcom,mdss-dsi-bl-pmic-control-type = "bl_ctrl_dcs";
		qcom,mdss-dsi-reset-sequence = <1 15>, <0 5>, <1 15>;
		qcom,mdss-dsi-lp11-init;
		qcom,mdss-dsi-init-delay-us = <50000>;
		qcom,mdss-pan-physical-width-dimension = <67>;
		qcom,mdss-pan-physical-height-dimension = <143>;
		qcom,esd-check-enabled;
		qcom,mdss-dsi-panel-status-read-length = <1>;
		qcom,mdss-dsi-panel-status-check-mode="reg_read";
		qcom,mdss-dsi-panel-status-command = [06 01 00 01 05 00 02 0A 08];
		qcom,mdss-dsi-panel-status-command-state = "dsi_lp_mode";
		qcom,mdss-dsi-panel-status-value = <0x9C>;
		qcom,mdss-dsi-cabc-off-command = [
                15 01 00 00 00 00 02 53 2C
                15 01 00 00 00 00 02 55 00];
		qcom,mdss-dsi-cabc-ui-command = [
                15 01 00 00 00 00 02 53 2C
                15 01 00 00 00 00 02 55 00];
		qcom,mdss-dsi-cabc-image-command = [
                15 01 00 00 00 00 02 53 2C
                15 01 00 00 00 00 02 55 00];
		qcom,mdss-dsi-cabc-video-command = [
                15 01 00 00 00 00 02 53 2C
                15 01 00 00 00 00 02 55 00];
	};
};
