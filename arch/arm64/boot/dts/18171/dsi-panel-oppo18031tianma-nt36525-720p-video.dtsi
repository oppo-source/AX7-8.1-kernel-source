/* Copyright (c) 2013, The Linux Foundation. All rights reserved.
 *
 * This program is free software; you can redistribute it and/or modify
 * it under the terms of the GNU General Public License version 2 and
 * only version 2 as published by the Free Software Foundation.
 *
 * This program is distributed in the hope that it will be useful,
 * but WITHOUT ANY WARRANTY; without even the implied warranty of
 * MERCHANTABILITY or FITNESS FOR A PARTICULAR PURPOSE.  See the
 * GNU General Public License for more details.
 */

/*---------------------------------------------------------------------------
 * This file is autogenerated file using gcdb parser. Please do not edit it.
 * Update input XML file to add a new entry or update variable in this file
 * VERSION = "1.0"
 *---------------------------------------------------------------------------*/
&mdss_mdp {
	dsi_oppo18031tianma_nt36525_720p_video: qcom,mdss_dsi_oppo18031tianma_nt36525_720p_video {
		qcom,mdss-dsi-panel-name = "oppo18031tianma nt36525 720p video mode dsi panel";
		qcom,mdss-dsi-panel-manufacture = "TIANMA";
		qcom,mdss-dsi-panel-version = "nt36525";
		qcom,mdss-dsi-panel-controller = <&mdss_dsi0>;
		qcom,mdss-dsi-panel-type = "dsi_video_mode";
		qcom,mdss-dsi-panel-destination = "display_1";
		qcom,mdss-dsi-panel-framerate = <60>;
		qcom,mdss-dsi-panel-clockrate = <720000000>;
		qcom,mdss-dsi-virtual-channel-id = <0>;
		qcom,mdss-dsi-stream = <0>;
		qcom,mdss-dsi-panel-width = <720>;
		qcom,mdss-dsi-panel-height = <1520>;
		qcom,mdss-dsi-h-front-porch = <200>;
		qcom,mdss-dsi-h-back-porch = <40>;
		qcom,mdss-dsi-h-pulse-width = <20>;
		qcom,mdss-dsi-h-sync-skew = <0>;
		qcom,mdss-dsi-v-back-porch = <4>;
		qcom,mdss-dsi-v-front-porch = <6>;
		qcom,mdss-dsi-v-pulse-width = <2>;
		qcom,mdss-dsi-h-left-border = <0>;
		qcom,mdss-dsi-h-right-border = <0>;
		qcom,mdss-dsi-v-top-border = <0>;
		qcom,mdss-dsi-v-bottom-border = <0>;
		qcom,mdss-dsi-bpp = <24>;
		qcom,mdss-dsi-underflow-color = <0xff>;
		qcom,mdss-dsi-border-color = <0>;
		qcom,mdss-dsi-on-command = [29 01 00 00 00 00 02 FF 23
			29 01 00 00 00 00 02 FB 01
			29 01 00 00 00 00 02 00 60
			29 01 00 00 00 00 02 05 24
			29 01 00 00 00 00 02 07 00
			29 01 00 00 00 00 02 45 FF
			29 01 00 00 00 00 02 46 FB
			29 01 00 00 00 00 02 47 F3
			29 01 00 00 00 00 02 48 EB
			29 01 00 00 00 00 02 49 E3
			29 01 00 00 00 00 02 4A DD
			29 01 00 00 00 00 02 4B D7
			29 01 00 00 00 00 02 4C D1
			29 01 00 00 00 00 02 4D CB
			29 01 00 00 00 00 02 4E C5
			29 01 00 00 00 00 02 4F BF
			29 01 00 00 00 00 02 50 B9
			29 01 00 00 00 00 02 51 B3
			29 01 00 00 00 00 02 52 AD
			29 01 00 00 00 00 02 53 A7
			29 01 00 00 00 00 02 54 A1
			29 01 00 00 00 00 02 FF 26
			29 01 00 00 00 00 02 FB 01
			29 01 00 00 00 00 02 19 1A
			29 01 00 00 00 00 02 FF 10
			29 01 00 00 00 00 02 FB 01
			29 01 00 00 00 00 03 51 07 FF
			29 01 00 00 00 00 02 53 24
			29 01 00 00 00 00 02 55 00
			29 01 00 00 00 00 02 B0 01
			29 01 00 00 00 00 02 BA 02
			29 01 00 00 05 00 02 29 00
			29 01 00 00 66 00 02 11 00];
		qcom,mdss-dsi-pwm-on-command = [29 01 00 00 00 00 02 FF 23
			29 01 00 00 00 00 02 FB 01
			29 01 00 00 00 00 02 00 60
			29 01 00 00 00 00 02 07 00
			29 01 00 00 00 00 02 FF 10
			29 01 00 00 00 00 02 FB 01
			29 01 00 00 00 00 03 51 00 00
			29 01 00 00 00 00 02 53 24
			29 01 00 00 00 00 02 55 00
			29 01 00 00 00 00 02 B0 01
			29 01 00 00 00 00 02 BA 02
			29 01 00 00 05 00 02 29 00
			29 01 00 00 66 00 02 11 00];
		qcom,mdss-dsi-off-command = [05 01 00 00 05 00 02 28 00
					05 01 00 00 44 00 02 10 00];
		qcom,mdss-dsi-on-command-state = "dsi_lp_mode";
		qcom,mdss-dsi-off-command-state = "dsi_lp_mode";
		qcom,mdss-dsi-h-sync-pulse = <1>;
		qcom,mdss-dsi-traffic-mode = "burst_mode";
		qcom,mdss-dsi-lane-map = "lane_map_012";
		qcom,mdss-dsi-bllp-eof-power-mode;
		qcom,mdss-dsi-bllp-power-mode;
		qcom,mdss-dsi-hfp-power-mode;
		qcom,mdss-dsi-lane-0-state;
		qcom,mdss-dsi-lane-1-state;
		qcom,mdss-dsi-lane-2-state;
		qcom,mdss-dsi-panel-timings = [8B 1E 14 00 42 46 18 20 19 03 04 00];
		qcom,mdss-dsi-t-clk-post = <0x01>;
		qcom,mdss-dsi-t-clk-pre = <0x29>;
		qcom,mdss-dsi-bl-min-level = <2>;
		qcom,mdss-dsi-bl-max-level = <2047>;
		qcom,mdss-brightness-max-level = <2047>;
		qcom,mdss-dsi-dma-trigger = "trigger_sw";
		qcom,mdss-dsi-mdp-trigger = "none";
		qcom,mdss-dsi-bl-pmic-control-type = "bl_ctrl_dcs";
		qcom,mdss-dsi-reset-sequence = <1 15>, <0 5>, <1 15>;
		qcom,mdss-dsi-lp11-init;
		qcom,mdss-dsi-init-delay-us = <50000>;
		qcom,mdss-pan-physical-width-dimension = <67>;
		qcom,mdss-pan-physical-height-dimension = <143>;
		qcom,esd-check-enabled;
		qcom,mdss-dsi-panel-status-read-length = <1>;
		qcom,mdss-dsi-panel-status-check-mode="reg_read";
		qcom,mdss-dsi-panel-status-command = [06 01 00 01 05 00 02 0A 08];
		qcom,mdss-dsi-panel-status-command-state = "dsi_lp_mode";
		qcom,mdss-dsi-panel-status-value = <0x9C>;
		qcom,mdss-dsi-cabc-off-command = [
                15 01 00 00 00 00 02 53 2C
                15 01 00 00 00 00 02 55 00];
		qcom,mdss-dsi-cabc-ui-command = [
                15 01 00 00 00 00 02 53 2C
                15 01 00 00 00 00 02 55 00];
		qcom,mdss-dsi-cabc-image-command = [
                15 01 00 00 00 00 02 53 2C
                15 01 00 00 00 00 02 55 00];
		qcom,mdss-dsi-cabc-video-command = [
                15 01 00 00 00 00 02 53 2C
                15 01 00 00 00 00 02 55 00];
	};
};
