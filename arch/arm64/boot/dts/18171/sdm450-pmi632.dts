/*
 * Copyright (c) 2018, The Linux Foundation. All rights reserved.
 *
 * This program is free software; you can redistribute it and/or modify
 * it under the terms of the GNU General Public License version 2 and
 * only version 2 as published by the Free Software Foundation.
 *
 * This program is distributed in the hope that it will be useful,
 * but WITHOUT ANY WARRANTY; without even the implied warranty of
 * MERCHANTABILITY or FITNESS FOR A PARTICULAR PURPOSE.  See the
 * GNU General Public License for more details.
 */

/dts-v1/;

#include "sdm450.dtsi"
#include "sdm450-pmi632.dtsi"

/ {
	model = "Qualcomm Technologies, Inc. SDM450 + PMI632 SOC";
	compatible = "qcom,sdm450";
	//#ifdef VENDOR_EDIT
	//Yunqing.Zeng@PSW.BSP.Boot, 2018-07-17, add for proj comm for dtbo & dtb
	qcom,board-id = <0xb 1 18171>;
	//#endif /* VENDOR_EDIT */
	qcom,pmic-id = <0x010016 0x25 0x0 0x0>;
	qcom,pmic-name = "PMI632";
};


//#ifdef VENDOR_EDIT//Fanhong.Kong@ProDrv.CHG,add 2016/6/11 for boot mode
/ {
	devinfo {
		compatible = "oppo-devinfo";
		Hw,sub_hwid_1 = <&tlmm 12 0x00>;
		Hw,sub_hwid_2=  <&tlmm 96 0x00>;
		//Hw,ant_select-gpio= <&tlmm 84 0x00>;
		pinctrl-names = "default", "sub_id_sleep";
		pinctrl-0 = <&hw_sub_gpio1_active &hw_sub_gpio2_active>;
		pinctrl-1 = <&hw_sub_gpio1_sleep &hw_sub_gpio2_sleep>;
	};
};
//#endif /*VENDOR_EDIT*/

