/* Copyright (c) 2013, The Linux Foundation. All rights reserved.
 *
 * This program is free software; you can redistribute it and/or modify
 * it under the terms of the GNU General Public License version 2 and
 * only version 2 as published by the Free Software Foundation.
 *
 * This program is distributed in the hope that it will be useful,
 * but WITHOUT ANY WARRANTY; without even the implied warranty of
 * MERCHANTABILITY or FITNESS FOR A PARTICULAR PURPOSE.  See the
 * GNU General Public License for more details.
 */

/*---------------------------------------------------------------------------
 * This file is autogenerated file using gcdb parser. Please do not edit it.
 * Update input XML file to add a new entry or update variable in this file
 * VERSION = "1.0"
 *---------------------------------------------------------------------------*/
&mdss_mdp {
	dsi_oppo18031csot_nt36672a_720p_video: qcom,mdss_dsi_oppo18031csot_nt36672a_720p_video {
		qcom,mdss-dsi-panel-name = "csot nt36672a 720p video mode dsi panel";
		qcom,mdss-dsi-panel-manufacture = "BOE_csot";
		qcom,mdss-dsi-panel-version = "nt36672a";
		qcom,mdss-dsi-panel-controller = <&mdss_dsi0>;
		qcom,mdss-dsi-panel-type = "dsi_video_mode";
		qcom,mdss-dsi-panel-destination = "display_1";
		qcom,mdss-dsi-panel-framerate = <60>;
		qcom,mdss-dsi-panel-clockrate = <720000000>;
		qcom,mdss-dsi-virtual-channel-id = <0>;
		qcom,mdss-dsi-stream = <0>;
		qcom,mdss-dsi-panel-width = <720>;
		qcom,mdss-dsi-panel-height = <1520>;
		qcom,mdss-dsi-h-front-porch = <122>;
		qcom,mdss-dsi-h-back-porch = <120>;
		qcom,mdss-dsi-h-pulse-width = <12>;
		qcom,mdss-dsi-h-sync-skew = <0>;
		qcom,mdss-dsi-v-back-porch = <8>;
		qcom,mdss-dsi-v-front-porch = <12>;
		qcom,mdss-dsi-v-pulse-width = <2>;
		qcom,mdss-dsi-h-left-border = <0>;
		qcom,mdss-dsi-h-right-border = <0>;
		qcom,mdss-dsi-v-top-border = <0>;
		qcom,mdss-dsi-v-bottom-border = <0>;
		qcom,mdss-dsi-bpp = <24>;
		qcom,mdss-dsi-underflow-color = <0xff>;
		qcom,mdss-dsi-border-color = <0>;
		qcom,mdss-dsi-on-command = [29 01 00 00 00 00 02 FF 20
			29 01 00 00 00 00 02 FB 01
			29 01 00 00 00 00 02 07 A8
			29 01 00 00 00 00 02 0F A4
			29 01 00 00 00 00 02 61 82
			29 01 00 00 00 00 02 62 97
			29 01 00 00 00 00 02 69 99
			29 01 00 00 00 00 02 6D 44
			29 01 00 00 00 00 02 94 00
			29 01 00 00 00 00 02 95 F5
			29 01 00 00 00 00 02 96 F5
			29 01 00 00 00 00 02 FF 20
			29 01 00 00 00 00 02 FB 01
			29 01 00 00 00 00 11 B0 00 00 00 1D 00 46 00 67 00 83 00 9B 00 B1 00 C4
			29 01 00 00 00 00 11 B1 00 D5 01 0F 01 38 01 7A 01 A8 01 F2 02 29 02 2B
			29 01 00 00 00 00 11 B2 02 63 02 A1 02 CB 02 FE 03 23 03 4B 03 5A 03 67
			29 01 00 00 00 00 0D B3 03 76 03 89 03 A0 03 C1 03 D7 03 DA
			29 01 00 00 00 00 11 B4 00 00 00 1D 00 46 00 67 00 83 00 9B 00 B1 00 C4
			29 01 00 00 00 00 11 B5 00 D5 01 0F 01 38 01 7A 01 A8 01 F2 02 29 02 2B
			29 01 00 00 00 00 11 B6 02 63 02 A1 02 CB 02 FE 03 23 03 4B 03 5A 03 67
			29 01 00 00 00 00 0D B7 03 76 03 89 03 A0 03 C1 03 D7 03 DA
			29 01 00 00 00 00 11 B8 00 00 00 1D 00 46 00 67 00 83 00 9B 00 B1 00 C4
			29 01 00 00 00 00 11 B9 00 D5 01 0F 01 38 01 7A 01 A8 01 F2 02 29 02 2B
			29 01 00 00 00 00 11 BA 02 63 02 A1 02 CB 02 FE 03 23 03 4B 03 5A 03 67
			29 01 00 00 00 00 0D BB 03 76 03 89 03 A0 03 C1 03 D7 03 DA
			29 01 00 00 00 00 02 FF 21
			29 01 00 00 00 00 02 FB 01
			29 01 00 00 00 00 11 B0 00 00 00 15 00 3E 00 5F 00 7B 00 93 00 A9 00 BC
			29 01 00 00 00 00 11 B1 00 CD 01 07 01 30 01 72 01 A0 01 EA 02 21 02 23
			29 01 00 00 00 00 11 B2 02 5B 02 99 02 C3 02 F6 03 1B 03 43 03 52 03 5F
			29 01 00 00 00 00 0D B3 03 6E 03 81 03 98 03 B9 03 D7 03 DA
			29 01 00 00 00 00 11 B4 00 00 00 15 00 3E 00 5F 00 7B 00 93 00 A9 00 BC
			29 01 00 00 00 00 11 B5 00 CD 01 07 01 30 01 72 01 A0 01 EA 02 21 02 23
			29 01 00 00 00 00 11 B6 02 5B 02 99 02 C3 02 F6 03 1B 03 43 03 52 03 5F
			29 01 00 00 00 00 0D B7 03 6E 03 81 03 98 03 B9 03 D7 03 DA
			29 01 00 00 00 00 11 B8 00 00 00 15 00 3E 00 5F 00 7B 00 93 00 A9 00 BC
			29 01 00 00 00 00 11 B9 00 CD 01 07 01 30 01 72 01 A0 01 EA 02 21 02 23
			29 01 00 00 00 00 11 BA 02 5B 02 99 02 C3 02 F6 03 1B 03 43 03 52 03 5F
			29 01 00 00 00 00 0D BB 03 6E 03 81 03 98 03 B9 03 D7 03 DA
			29 01 00 00 00 00 02 FF 23
			29 01 00 00 00 00 02 FB 01
			29 01 00 00 00 00 02 00 60
			29 01 00 00 00 00 02 05 24
			29 01 00 00 00 00 02 07 00
			29 01 00 00 00 00 02 12 AB
			29 01 00 00 00 00 02 15 F5
			29 01 00 00 00 00 02 16 0B
			29 01 00 00 00 00 02 45 FF
			29 01 00 00 00 00 02 46 FB
			29 01 00 00 00 00 02 47 F3
			29 01 00 00 00 00 02 48 EB
			29 01 00 00 00 00 02 49 E3
			29 01 00 00 00 00 02 4A DD
			29 01 00 00 00 00 02 4B D7
			29 01 00 00 00 00 02 4C D1
			29 01 00 00 00 00 02 4D CB
			29 01 00 00 00 00 02 4E C5
			29 01 00 00 00 00 02 4F BF
			29 01 00 00 00 00 02 50 B9
			29 01 00 00 00 00 02 51 B3
			29 01 00 00 00 00 02 52 AD
			29 01 00 00 00 00 02 53 A7
			29 01 00 00 00 00 02 54 A1
			29 01 00 00 00 00 02 FF 24
			29 01 00 00 00 00 02 FB 01
			29 01 00 00 00 00 02 00 1C
			29 01 00 00 00 00 02 01 1C
			29 01 00 00 00 00 02 02 1C
			29 01 00 00 00 00 02 03 1C
			29 01 00 00 00 00 02 04 1C
			29 01 00 00 00 00 02 05 1C
			29 01 00 00 00 00 02 06 1C
			29 01 00 00 00 00 02 07 1C
			29 01 00 00 00 00 02 08 1C
			29 01 00 00 00 00 02 09 1C
			29 01 00 00 00 00 02 0A 20
			29 01 00 00 00 00 02 0B 20
			29 01 00 00 00 00 02 0C 10
			29 01 00 00 00 00 02 0D 12
			29 01 00 00 00 00 02 0E 14
			29 01 00 00 00 00 02 0F 1E
			29 01 00 00 00 00 02 10 0D
			29 01 00 00 00 00 02 11 0A
			29 01 00 00 00 00 02 12 01
			29 01 00 00 00 00 02 13 05
			29 01 00 00 00 00 02 14 03
			29 01 00 00 00 00 02 15 04
			29 01 00 00 00 00 02 16 06
			29 01 00 00 00 00 02 17 1C
			29 01 00 00 00 00 02 18 1C
			29 01 00 00 00 00 02 19 1C
			29 01 00 00 00 00 02 1A 1C
			29 01 00 00 00 00 02 1B 1C
			29 01 00 00 00 00 02 1C 1C
			29 01 00 00 00 00 02 1D 1C
			29 01 00 00 00 00 02 1E 1C
			29 01 00 00 00 00 02 1F 1C
			29 01 00 00 00 00 02 20 1C
			29 01 00 00 00 00 02 21 20
			29 01 00 00 00 00 02 22 00
			29 01 00 00 00 00 02 23 10
			29 01 00 00 00 00 02 24 12
			29 01 00 00 00 00 02 25 14
			29 01 00 00 00 00 02 26 1E
			29 01 00 00 00 00 02 27 0D
			29 01 00 00 00 00 02 28 0A
			29 01 00 00 00 00 02 29 01
			29 01 00 00 00 00 02 2A 04
			29 01 00 00 00 00 02 2B 06
			29 01 00 00 00 00 02 2D 03
			29 01 00 00 00 00 02 2F 05
			29 01 00 00 00 00 02 31 04
			29 01 00 00 00 00 02 32 08
			29 01 00 00 00 00 02 33 04
			29 01 00 00 00 00 02 34 08
			29 01 00 00 00 00 02 35 00
			29 01 00 00 00 00 02 37 01
			29 01 00 00 00 00 02 38 A7
			29 01 00 00 00 00 02 39 A7
			29 01 00 00 00 00 02 3F A7
			29 01 00 00 00 00 02 41 04
			29 01 00 00 00 00 02 42 08
			29 01 00 00 00 00 02 4C 09
			29 01 00 00 00 00 02 4D 09
			29 01 00 00 00 00 02 60 51
			29 01 00 00 00 00 02 61 F0
			29 01 00 00 00 00 02 79 22
			29 01 00 00 00 00 02 7A 0D
			29 01 00 00 00 00 02 7B AA
			29 01 00 00 00 00 02 7D 26
			29 01 00 00 00 00 02 80 42
			29 01 00 00 00 00 02 82 11
			29 01 00 00 00 00 02 83 22
			29 01 00 00 00 00 02 84 33
			29 01 00 00 00 00 02 85 00
			29 01 00 00 00 00 02 86 00
			29 01 00 00 00 00 02 87 00
			29 01 00 00 00 00 02 88 11
			29 01 00 00 00 00 02 89 22
			29 01 00 00 00 00 02 8A 33
			29 01 00 00 00 00 02 8B 00
			29 01 00 00 00 00 02 8C 00
			29 01 00 00 00 00 02 8D 00
			29 01 00 00 00 00 02 92 B0
			29 01 00 00 00 00 02 B3 0A
			29 01 00 00 00 00 02 B4 04
			29 01 00 00 00 00 02 DC 29
			29 01 00 00 00 00 02 DD 03
			29 01 00 00 00 00 02 DE 03
			29 01 00 00 00 00 02 DF 01
			29 01 00 00 00 00 02 E0 A8
			29 01 00 00 00 00 02 EB 0D
			29 01 00 00 00 00 02 FF 25
			29 01 00 00 00 00 02 FB 01
			29 01 00 00 00 00 02 21 2A
			29 01 00 00 00 00 02 22 2A
			29 01 00 00 00 00 02 24 B0
			29 01 00 00 00 00 02 25 B0
			29 01 00 00 00 00 02 28 00
			29 01 00 00 00 00 02 29 B0
			29 01 00 00 00 00 02 2A 00
			29 01 00 00 00 00 02 2B B0
			29 01 00 00 00 00 02 69 60
			29 01 00 00 00 00 02 71 5D
			29 01 00 00 00 00 02 7E 2D
			29 01 00 00 00 00 02 84 78
			29 01 00 00 00 00 02 8D 00
			29 01 00 00 00 00 02 C2 59
			29 01 00 00 00 00 02 C3 13
			29 01 00 00 00 00 02 D0 01
			29 01 00 00 00 00 02 D4 00
			29 01 00 00 00 00 02 D5 02
			29 01 00 00 00 00 02 D6 20
			29 01 00 00 00 00 02 D9 88
			29 01 00 00 00 00 02 FF 26
			29 01 00 00 00 00 02 FB 01
			29 01 00 00 00 00 02 06 FF
			29 01 00 00 00 00 02 12 4C
			29 01 00 00 00 00 02 1A 5B
			29 01 00 00 00 00 02 1C AF
			29 01 00 00 00 00 02 1E DE
			29 01 00 00 00 00 02 98 F1
			29 01 00 00 00 00 02 AE 48
			29 01 00 00 00 00 02 FF 27
			29 01 00 00 00 00 02 FB 01
			29 01 00 00 00 00 02 13 00
			29 01 00 00 00 00 02 1E 15
			29 01 00 00 00 00 02 FF F0
			29 01 00 00 00 00 02 FB 01
			29 01 00 00 00 00 02 A2 00
			29 01 00 00 00 00 02 FF 10
			29 01 00 00 00 00 02 FB 01
			29 01 00 00 00 00 03 51 07 FF
			29 01 00 00 00 00 02 53 24
			29 01 00 00 00 00 02 55 00
			29 01 00 00 00 00 02 B0 01
			29 01 00 00 00 00 02 BA 02
			29 01 00 00 64 00 02 11 00
			29 01 00 00 14 00 02 29 00];
		qcom,mdss-dsi-off-command = [05 01 00 00 32 00 02 28 00
					05 01 00 00 78 00 02 10 00];
		qcom,mdss-dsi-on-command-state = "dsi_lp_mode";
		qcom,mdss-dsi-off-command-state = "dsi_lp_mode";
		qcom,mdss-dsi-h-sync-pulse = <1>;
		qcom,mdss-dsi-traffic-mode = "burst_mode";
		qcom,mdss-dsi-lane-map = "lane_map_012";
		qcom,mdss-dsi-bllp-eof-power-mode;
		qcom,mdss-dsi-bllp-power-mode;
		qcom,mdss-dsi-lane-0-state;
		qcom,mdss-dsi-lane-1-state;
		qcom,mdss-dsi-lane-2-state;
		qcom,mdss-dsi-panel-timings = [8B 1E 14 00 42 46 18 20 19 03 04 00];
		qcom,mdss-dsi-t-clk-post = <0x0C>;
		qcom,mdss-dsi-t-clk-pre = <0x29>;
		qcom,mdss-dsi-bl-min-level = <2>;
		qcom,mdss-dsi-bl-max-level = <2047>;
		qcom,mdss-brightness-max-level = <2047>;
		qcom,mdss-dsi-dma-trigger = "trigger_sw";
		qcom,mdss-dsi-mdp-trigger = "none";
		qcom,mdss-dsi-bl-pmic-control-type = "bl_ctrl_dcs";
		qcom,mdss-dsi-reset-sequence = <1 15>, <0 5>, <1 15>;
		qcom,mdss-dsi-lp11-init;
		qcom,mdss-dsi-init-delay-us = <50000>;
		qcom,mdss-pan-physical-width-dimension = <67>;
		qcom,mdss-pan-physical-height-dimension = <143>;
		qcom,esd-check-enabled;
		qcom,mdss-dsi-panel-status-read-length = <1>;
		qcom,mdss-dsi-panel-status-check-mode="reg_read";
		qcom,mdss-dsi-panel-status-command = [06 01 00 01 05 00 02 0A 08];
		qcom,mdss-dsi-panel-status-command-state = "dsi_lp_mode";
		qcom,mdss-dsi-panel-status-value = <0x9C>;
		qcom,mdss-dsi-cabc-off-command = [
                15 01 00 00 00 00 02 53 2C
                15 01 00 00 00 00 02 55 00];
		qcom,mdss-dsi-cabc-ui-command = [
                15 01 00 00 00 00 02 53 2C
                15 01 00 00 00 00 02 55 00];
		qcom,mdss-dsi-cabc-image-command = [
                15 01 00 00 00 00 02 53 2C
                15 01 00 00 00 00 02 55 00];
		qcom,mdss-dsi-cabc-video-command = [
                15 01 00 00 00 00 02 53 2C
                15 01 00 00 00 00 02 55 00];
	};
};
